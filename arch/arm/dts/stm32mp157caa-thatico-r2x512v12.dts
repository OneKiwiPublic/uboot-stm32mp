// SPDX-License-Identifier: (GPL-2.0+ OR BSD-3-Clause)
/*
 * Copyright (C) STMicroelectronics 2019 - All Rights Reserved
 * Author: Alexandre Torgue <alexandre.torgue@st.com> for STMicroelectronics.
 */

/dts-v1/;

#include "stm32mp157.dtsi"
#include "stm32mp15xa.dtsi"
#include "stm32mp15-pinctrl.dtsi"
#include "stm32mp15xxaa-pinctrl.dtsi"
#include "stm32mp157caa-thatico-r2x512v12.dtsi"
#include "stm32mp157caa-thatico-r2x512v12-pin.dtsi"

/ {
	model = "THATICO STM32MP157CAA3 1GB V1.2 Board";
	compatible = "st,stm32mp157caa-thatico-r2x512v12", "st,stm32mp157";

	aliases {
		serial0 = &uart4;
		serial1 = &usart3;
		serial2 = &usart2;
	};

	chosen {
		stdout-path = "serial0:115200n8";
	};
};
